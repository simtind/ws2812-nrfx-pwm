## drivers/Kconfig
```kconfig
# drivers configuration options

# Copyright (c) 2015 Intel Corporation
# SPDX-License-Identifier: Apache-2.0

menu "Device Drivers"

source "drivers/led_strip/Kconfig"

endmenu
```

## drivers/led_strip/Kconfig
```kconfig
# Top-level configuration file for LED strip drivers.

# Copyright (c) 2017 Linaro Limited
# Copyright (c) 2018 Intel Corporation
# SPDX-License-Identifier: Apache-2.0

menuconfig LED_STRIP
	bool "LED strip drivers"
	help
	  Include LED strip drivers in the system configuration.

if LED_STRIP

module = LED_STRIP
module-str = LED strip
source "subsys/logging/Kconfig.template.log_config"

config LED_STRIP_INIT_PRIORITY
	int "LED strip initialization priority"
	default 90
	help
	  System initialization priority for LED strip drivers.

source "drivers/led_strip/Kconfig.ws2812"

endif # LED_STRIP
```

## dts/bindings/led_strip/worldsemi,ws2812-pwm.yaml
```yaml
# Copyright (c) 2019, Nordic Semiconductor ASA
# SPDX-License-Identifier: Apache-2.0

description: |
  Worldsemi WS2812 LED strip, nRFX PWM binding

  Driver bindings for controlling a WS2812 or compatible LED
  strip with a PWM output.

  Use of this driver implies an 16x internal memory overhead (2 bytes of
  driver RAM overhead per bit of pixel data).

compatible: "worldsemi,ws2812-pwm"

include: 
  - ws2812.yaml
  - pinctrl-device.yaml
  - name: base.yaml
    property-allowlist: [label, status]

properties:
  label:
    required: false
    type: string
    description: |
      Human readable string describing the LED. It can be used by an
      application to identify this LED or to retrieve its number/index
      (i.e. child node number) on the parent device. 
  out-pin:
    type: int
    required: true
    description: |
      The RGB strip data pin.

  pwm-instance:
    type: phandle
    required: true
    description: Node label of target PWM instance.
    
  pwm-inverted:
    type: boolean
    required: false
    description: Invert data output.
  
  pwm-one-frame:
    type: int
    required: false
    default: 0x000D
    description: 16-bit PWM frame to shift out for a 1 pulse.

  pwm-zero-frame:
    type: int
    required: false
    default: 0x0006
    description: 16-bit SPI frame to shift out for a 0 pulse.
```

## modules/ws2812_nrfx_pwm/Kconfig
```kconfig
# Top-level configuration file for LED strip drivers.

# Copyright (c) 2017 Linaro Limited
# Copyright (c) 2018 Intel Corporation
# SPDX-License-Identifier: Apache-2.0

config WS2812_STRIP_NRFX_PWM
	bool "PWM driver"
	depends on NRFX_PWM
	help
	  Enable LED strip driver for daisy chains of WS2812-ish (or WS2812B,
	  WS2813, SK6812, Everlight B1414, or compatible) devices using the nrfx PWM driver.
	  The nRFx PWM driver only uses a single pin, but requires significantly more
	  memory (2 bytes of overhead per bit of pixel data).
```

## west.yml
```yaml
manifest:
  version: "0.12"
  # West-related configuration for the repository.
  self:
    # This repository should be cloned to ncs/nrf.
    path: ws2812_nrfx_pwm
```
